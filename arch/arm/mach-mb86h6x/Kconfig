## arch/arm/mach-mb86h6x/Kconfig
```kconfig
config MB86H60
	bool "Fujitsu MB86H60 SoC support"
	depends on ARCH_MB86H6X
	select CPU_ARM1176

menu "Fujitsu MB86H6X family"
	depends on ARCH_MB86H6X

choice
	prompt "Fujitsu MB86H6X board select"
	optional

config TARGET_H60_STB
	bool "Fujitsu STB (all MB86H60 variants)"
	help
	  Support for all ARM1176-/MB86H60-based boards variants
	select MB86H60 

config TARGET_H61_STB
	bool "Fujitsu STB (all MB86H61 variants)"
	help
	  Support for all ARM1176-/MB86H61-based boards variants
	select MB86H61

endchoice

config SYS_BOARD
	default "mb86h60_stb"

config SYS_VENDOR
	default "fujitsu"

config SYS_SOC
	default "mb86h6x"

config SYS_CONFIG_NAME
	default "mb86h60_stb"

source "board/fujitsu/mb86h60_stb/Kconfig"

endmenu
```

## arch/arm/mach-rtd129x/Kconfig
```kconfig
menu "Realtek RTD129X"
	depends on ARCH_RTD129X

choice
	prompt "RealTek RTD129X platform select"
	optional

config TARGET_RTD1295
	bool "Support RealTek 1295 platform"

config TARGET_RTD1296
	bool "Support RealTek 1296 platform"
	depends on TARGET_RTD1295

endchoice

config SYS_CONFIG_NAME
	default "rtd1296_qa_sd_bananapi"

endmenu
```

## configs/mb86h60_stb_defconfig
```kconfig
CONFIG_ARM=y
CONFIG_ARCH_CPU_INIT=y
CONFIG_ARCH_MB86H6X=y
CONFIG_SYS_TEXT_BASE=0x23F00000
#CONFIG_SYS_TEXT_BASE=0x40000000
CONFIG_SYS_MALLOC_F_LEN=0x1000
# CONFIG_TARGET_RPI_0_W=y
CONFIG_TARGET_H60_STB=y
#CONFIG_ENV_SIZE=0x4000
CONFIG_OF_CONTROL=y
CONFIG_OF_SEPARATE=y
CONFIG_DEFAULT_DEVICE_TREE="mb86h60_stb"
#CONFIG_DISTRO_DEFAULTS=y
CONFIG_OF_LIBFDT=y
CONFIG_OF_BOARD_SETUP=y
#CONFIG_USE_PREBOOT=y
# CONFIG_DISPLAY_CPUINFO is not set
# CONFIG_DISPLAY_BOARDINFO is not set
#CONFIG_MISC_INIT_R=y
CONFIG_SYS_PROMPT="U-Boot> "
CONFIG_CMD_GPIO=y
#CONFIG_CMD_MMC=y
#CONFIG_CMD_USB=y
#CONFIG_CMD_FS_UUID=y
#CONFIG_ENV_FAT_DEVICE_AND_PART="0:1"
#CONFIG_SYS_RELOC_GD_ENV_ADDR=y
#CONFIG_ENV_VARS_UBOOT_RUNTIME_CONFIG=y
CONFIG_MMC=n
#CONFIG_DM_MMC=y
#CONFIG_MMC_SDHCI=y
#CONFIG_MMC_SDHCI_BCM2835=y
#CONFIG_DM_ETH=y
CONFIG_PINCONF=y
CONFIG_PINCTRL=y
# CONFIG_PINCTRL_GENERIC is not set
# CONFIG_REQUIRE_SERIAL_CONSOLE is not set
#CONFIG_USB=y
#CONFIG_DM_USB=y
#CONFIG_USB_DWC2=y
#CONFIG_USB_KEYBOARD=y
#CONFIG_USB_HOST_ETHER=y
#CONFIG_USB_ETHER_SMSC95XX=y
#CONFIG_DM_VIDEO=y
# CONFIG_VIDEO_BPP8 is not set
# CONFIG_VIDEO_BPP16 is not set
#CONFIG_SYS_WHITE_ON_BLACK=y
#CONFIG_CONSOLE_SCROLL_LINES=10
#CONFIG_PHYS_TO_BUS=y
#CONFIG_OF_LIBFDT_OVERLAY=y
#CONFIG_EFI_LOADER=y
CONFIG_CMD_DM=y
CONFIG_DM_SERIAL=y
CONFIG_PL01X_SERIAL=y
CONFIG_PRE_CONSOLE_BUFFER=y
CONFIG_PRE_CON_BUF_ADDR=0x22b00000
CONFIG_PRE_CON_BUF_SZ=1024
CONFIG_MTD=y
CONFIG_DM_MTD=y
CONFIG_CMD_MTD=y
CONFIG_SPI=y
CONFIG_DM_SPI_FLASH=y
CONFIG_DM_SPI=y
CONFIG_SPI_FLASH_STMICRO=y
CONFIG_SPI_FLASH_MTD=y
CONFIG_MTDIDS_DEFAULT="nor0=spiflash"
CONFIG_MTDPARTS_DEFAULT="mtdparts=spiflash:512k(uboot),64k(part1),64k(part2)"
CONFIG_PL022_SPI=y
CONFIG_USB=y
CONFIG_DM_USB=y
# CONFIG_SPL_DM_USB is not set
#CONFIG_USB_OHCI_HCD=y
#CONFIG_USB_OHCI_DA8XX=y
CONFIG_USB_MUSB_HOST=y
CONFIG_USB_MUSB_MB86H60=y
CONFIG_USB_MUSB_PIO_ONLY=y
CONFIG_USB_STORAGE=y
CONFIG_USB_HOST_ETHER=y
CONFIG_USB_ETHER_ASIX=y
CONFIG_CMD_USB=y
CONFIG_CMD_FAT=y
CONFIG_CMD_PING=y
CONFIG_CMD_NET=y
CONFIG_CMD_DHCP=y
```

## configs/rtd1296_sd_bananapi_defconfig
```kconfig
CONFIG_ARM=y
#CONFIG_SYS_ARCH_TIMER=n
CONFIG_ARCH_RTD129X=y
CONFIG_TARGET_RTD1296=y
CONFIG_TARGET_RTD1295=y
##CONFIG_SYS_TEXT_BASE=0x00020000
CONFIG_SYS_TEXT_BASE=0x1500000

CONFIG_DM=y
CONFIG_CMD_DM=y
CONFIG_OF_LIBFDT=y
CONFIG_OF_CONTROL=y
CONFIG_OF_SEPARATE=y
#CONFIG_OF_EMBED=y
CONFIG_DEFAULT_DEVICE_TREE="rtd-1296-bananapi-w2-2GB"

CONFIG_SYS_NS16550=y
CONFIG_DM_SERIAL=y

#CONFIG_BOARD_QA=y
#CONFIG_SYS_MALLOC_CLEAR_ON_INIT=y
#CONFIG_RTK_XEN_MONITOR_SUPPORT=y
#CONFIG_RTK_SLAVE_CPU_BOOT=y
#CONFIG_SYS_CONFIG_NAME="rtd1296_qa_sd_bananapi"
#CONFIG_RTK_MMC_DRIVER=y

#CONFIG_RTK_SD_DRIVER=y
#CONFIG_DM_MMC=y
#CONFIG_MMC_TRACE=y
#CONFIG_MMC_VERBOSE=y
#CONFIG_CMD_MMC=y
#CONFIG_CMD_SD=y

#CONFIG_MMC_IO_VOLTAGE=y
#CONFIG_MMC_UHS_SUPPORT=y
#CONFIG_MMC_HS200_SUPPORT=y

#
# Enabled commands
#
#CONFIG_CMD_UNZIP=y
#CONFIG_CMD_SOURCE=y
#CONFIG_CMD_GETTIME=y
#CONFIG_CMD_GICTEST=y
#CONFIG_CMD_CACHETEST=y
#CONFIG_CMD_BOOTR=y
#CONFIG_CMD_BOOTM=y
#CONFIG_CMD_NET=y
#CONFIG_CMD_TFTPPUT=y
CONFIG_CMD_USB=y
CONFIG_CMD_FAT=y
CONFIG_CMD_EXT2=y
CONFIG_CMD_EXT4=y
CONFIG_CMD_EXT4_WRITE=y
#CONFIG_CMD_I2C=y
CONFIG_USB=y
#CONFIG_DM_USB=y
CONFIG_USB_RTK=y
CONFIG_USB_EHCI_HCD=y
CONFIG_USB_EHCI_RTK=y
#CONFIG_USB_XHCI_HCD=y
#CONFIG_USB_XHCI_RTK=y

CONFIG_BLK=n
CONFIG_USB_STORAGE=y
CONFIG_USB_HOST_ETHER=y
CONFIG_USB_ETHER_ASIX=y

#CONFIG_GMT_G2227=y

#CONFIG_USB_DWC3=y
# CONFIG_USB_DWC3_HOST is not set
# CONFIG_USB_DWC3_GADGET is not set
CONFIG_USB_DWC3_DUAL_ROLE=y

#
# Platform Glue Driver Support
#
CONFIG_USB_DWC3_RTK=y
CONFIG_USB_RTK_DWC3_DRD_MODE=y
# CONFIG_USB_TYPE_C_RTK_RTS5400 is not set
CONFIG_USB_DWC3_PCI=y
CONFIG_USB_DWC3_OF_SIMPLE=y

#
# Disabled commands
#

# CONFIG_CMD_NFS is not set
# CONFIG_CMD_IMLS is not set
# CONFIG_CMD_FPGA is not set
# CONFIG_CMD_BOOTD is not set
# CONFIG_CMD_CRC32 is not set
# CONFIG_CMD_ECHO is not set
# CONFIG_CMD_ITEST is not set
# CONFIG_CMD_XIMG is not set
# CONFIG_CMD_MISC is not set
# CONFIG_CMD_SETGETDCR is not set
# CONFIG_CMD_IMI is not set
# CONFIG_CMD_IMPORTENV is not set
# CONFIG_CMD_EXPORTENV is not set
# CONFIG_CMD_RUN is not set
# CONFIG_CMD_BASE is not set
# CONFIG_CMD_LOOP is not set
# CONFIG_CMD_TEST is not set
# CONFIG_CMD_TRUE is not set
# CONFIG_CMD_FALSE is not set
# CONFIG_CMD_LOADS is not set
#CONFIG_CMD_LOADB=y
# CONFIG_CMD_EXIT is not set
# CONFIG_CMD_CONSOLE is not set
# CONFIG_CMD_SHOWVAR is not set
# CONFIG_CMD_MM is not set
# CONFIG_CMD_NM is not set
# CONFIG_CMD_CMP is not set
# CONFIG_CMD_CP is not set

#
# Others
#
# CONFIG_CUSTOMIZE_ACCELERATE_BOOT_BLUE_LOGO is not set
```

## drivers/pinctrl/fujitsu/Kconfig
```kconfig
config PINCTRL_MB86H6X
	depends on ARCH_MB86H6X && PINCTRL_FULL && OF_CONTROL
	default y
	bool "Fujitsu MB86H6x family pin control driver"
	help
	   Support pin multiplexing and pin configuration control on
	   Fujitsu's MB86H6x family of SoCs.
```
